## firmware/main/Kconfig.projbuild
```kconfig
menu "Hermes Configuration"

    config HERMES_UI_CONSOLE
        bool "Also log UI state to UART console"
        default n
        help
            LCD + touch is the primary UI. Enable this for extra UART dumps.

endmenu
```

## firmware/sdkconfig.defaults
```kconfig
CONFIG_IDF_TARGET="esp32s3"
CONFIG_ESPTOOLPY_FLASHSIZE_16MB=y
CONFIG_PARTITION_TABLE_CUSTOM=y
CONFIG_PARTITION_TABLE_CUSTOM_FILENAME="partitions.csv"
CONFIG_ESP_WIFI_SOFTAP_SUPPORT=n
CONFIG_MBEDTLS_CERTIFICATE_BUNDLE=y

# ESP32-S3R8 octal PSRAM (framebuffer lives here)
CONFIG_SPIRAM=y
CONFIG_SPIRAM_MODE_OCT=y
CONFIG_SPIRAM_SPEED_80M=y
CONFIG_SPIRAM_USE_MALLOC=y
CONFIG_SPIRAM_MALLOC_ALWAYSINTERNAL=4096

# Hermes defaults
CONFIG_HERMES_UI_CONSOLE=n
```
