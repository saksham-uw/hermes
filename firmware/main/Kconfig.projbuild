## firmware/main/Kconfig.projbuild
```kconfig
menu "Hermes Configuration"

    config HERMES_WIFI_SSID
        string "WiFi SSID"
        default "YOUR_WIFI"

    config HERMES_WIFI_PASSWORD
        string "WiFi password"
        default "YOUR_PASSWORD"

    config HERMES_IOT_ENDPOINT
        string "AWS IoT Core ATS endpoint"
        default "acp99wijypwjp-ats.iot.us-east-1.amazonaws.com"

    config HERMES_USER_ID
        string "Hermes user id (topic prefix)"
        default "saksham"

    config HERMES_THING_NAME
        string "IoT Thing / MQTT client id"
        default "hermes-device"

    config HERMES_UI_CONSOLE
        bool "Also log UI state to UART console"
        default n
        help
            LCD + touch is the primary UI. Enable this for extra UART dumps.

    config HERMES_BOOT_GPIO
        int "BOOT GPIO (active low)"
        default 0

endmenu
```

## firmware/sdkconfig.defaults
```kconfig
CONFIG_IDF_TARGET="esp32s3"
CONFIG_ESPTOOLPY_FLASHSIZE_16MB=y
CONFIG_ESP_WIFI_SOFTAP_SUPPORT=n
CONFIG_MBEDTLS_CERTIFICATE_BUNDLE=y

# ESP32-S3R8 octal PSRAM (framebuffer lives here)
CONFIG_SPIRAM=y
CONFIG_SPIRAM_MODE_OCT=y
CONFIG_SPIRAM_SPEED_80M=y
CONFIG_SPIRAM_USE_MALLOC=y
CONFIG_SPIRAM_MALLOC_ALWAYSINTERNAL=4096

# Hermes defaults (override in menuconfig)
CONFIG_HERMES_WIFI_SSID="roger7459"
CONFIG_HERMES_WIFI_PASSWORD="Sharry22#%"
CONFIG_HERMES_IOT_ENDPOINT="acp99wijypwjp-ats.iot.us-east-1.amazonaws.com"
CONFIG_HERMES_USER_ID="saksham"
CONFIG_HERMES_THING_NAME="hermes-device"
CONFIG_HERMES_UI_CONSOLE=n
```
